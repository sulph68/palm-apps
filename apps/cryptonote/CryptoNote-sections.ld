/* DO NOT EDIT!
   This file was automatically generated by m68k-palmos-multigen v2.3
   from CryptoNote.def  */

MEMORY
{
	sec001res : ORIGIN = 0x0, LENGTH = 32768
}

SECTIONS
{
	sec001 : { *(sec001) } > sec001res
}
